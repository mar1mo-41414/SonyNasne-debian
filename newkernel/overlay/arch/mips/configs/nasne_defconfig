## newkernel/overlay/arch/mips/configs/nasne_defconfig
```kconfig
# Sony nasne (ViXS XCode 4210 "Viper", MIPS 74Kc LE) 用。メディアエンジン(xcode4drv)なしの素のLinux。
CONFIG_MIPS_XCODE=y
CONFIG_CPU_LITTLE_ENDIAN=y
CONFIG_CPU_MIPS32_R2=y
CONFIG_32BIT=y
CONFIG_PAGE_SIZE_4KB=y
CONFIG_HZ_100=y
CONFIG_PREEMPT_NONE=y
CONFIG_LOCALVERSION="-nasne"
CONFIG_DEFAULT_HOSTNAME="nasne"
# 小さく(KNLスロットは gzip 後 2.5MB)
CONFIG_CC_OPTIMIZE_FOR_SIZE=y
CONFIG_EXPERT=y
CONFIG_EMBEDDED=y
# CONFIG_MODULES is not set
# CONFIG_SWAP is not set
# CONFIG_SYSVIPC is not set
# CONFIG_POSIX_MQUEUE is not set
# CONFIG_CROSS_MEMORY_ATTACH is not set
# CONFIG_AUDIT is not set
# CONFIG_NAMESPACES is not set
# CONFIG_IO_URING is not set
# CONFIG_ADVISE_SYSCALLS is not set
# CONFIG_KALLSYMS is not set
# CONFIG_MIPS_MT_SMP is not set
# CONFIG_COMPAT_BRK is not set
CONFIG_BLK_DEV_INITRD=y
CONFIG_INITRAMFS_ROOT_UID=0
CONFIG_INITRAMFS_ROOT_GID=0
CONFIG_RD_GZIP=y
# CONFIG_RD_BZIP2 is not set
# CONFIG_RD_LZMA is not set
# CONFIG_RD_XZ is not set
# CONFIG_RD_LZO is not set
# CONFIG_RD_LZ4 is not set
# CONFIG_RD_ZSTD is not set
CONFIG_PRINTK=y
CONFIG_PROC_FS=y
CONFIG_SYSFS=y
CONFIG_TMPFS=y
CONFIG_DEVTMPFS=y
CONFIG_DEVMEM=y
# CONFIG_STRICT_DEVMEM is not set
CONFIG_BINFMT_ELF=y
CONFIG_MIPS_FP_SUPPORT=y
# CONFIG_XCODE_LED_DEBUG is not set
# CONFIG_VT is not set
# CONFIG_SERIO is not set
# CONFIG_INPUT is not set
# CONFIG_NETWORK_FILESYSTEMS is not set
# CONFIG_WIRELESS is not set
CONFIG_PANIC_TIMEOUT=0
CONFIG_NET=y
CONFIG_INET=y
CONFIG_PACKET=y
CONFIG_UNIX=y
CONFIG_NETDEVICES=y
CONFIG_XCODE_GMAC=y
CONFIG_MARVELL_PHY=y
CONFIG_NETCONSOLE=y
CONFIG_NETCONSOLE_DYNAMIC=y
# CONFIG_IPV6 is not set
CONFIG_IP_PNP=y
CONFIG_IP_PNP_DHCP=n
CONFIG_SCSI=y
CONFIG_BLK_DEV_SD=y
CONFIG_ATA=y
CONFIG_SATA_XCODE=y
CONFIG_ATA_VERBOSE_ERROR=y
CONFIG_PARTITION_ADVANCED=y
CONFIG_MSDOS_PARTITION=y
CONFIG_EFI_PARTITION=y
CONFIG_EXT4_FS=y
CONFIG_XFS_FS=y
CONFIG_BLK_DEV_LOOP=y
CONFIG_PRINTK_TIME=y
CONFIG_I2C=y
CONFIG_I2C_CHARDEV=y
CONFIG_I2C_XCODE=y
CONFIG_MISC_DEVICES=y
CONFIG_MTD=y
CONFIG_MTD_SPI_NOR=y
CONFIG_SPI=y
CONFIG_SPI_XCODE=y
CONFIG_NASNE_MCU=y
CONFIG_PAGE_POISONING=y
CONFIG_DEBUG_KERNEL=y
# KNL スロット(gzip 後 2.5MB)に収めるため、診断用の機能を外す
# CONFIG_DEBUG_FS is not set
# CONFIG_BLK_DEBUG_FS is not set
# CONFIG_INET_DIAG is not set
# CONFIG_SCSI_PROC_FS is not set
# CONFIG_SYSFS_SYSCALL is not set
# SPI フラッシュ(MTD)を足した分(+60KB)を KNL スロットに収めるため、ほかを外す
# CONFIG_KEXEC is not set
# CONFIG_CRASH_DUMP is not set
# CONFIG_MIGRATION is not set
# CONFIG_COMPACTION is not set
# CONFIG_NET_SELFTESTS is not set
# CONFIG_ETHTOOL_NETLINK is not set
# CONFIG_PAGE_POISONING is not set
# CONFIG_MQ_IOSCHED_KYBER is not set
# CONFIG_BLK_DEV_BSG is not set
# CONFIG_MTD_SPI_NOR_USE_4K_SECTORS is not set
# CONFIG_MTD_SPI_NOR_SWP_DISABLE_ON_VOLATILE is not set
# CONFIG_DEBUG_MISC is not set
# xcode4drv(メディアエンジン・チューナー)をモジュールで使う。輸出シンボルは xc4drv/ksyms_whitelist.txt の分だけ(build.sh が設定)
CONFIG_MODULES=y
# CONFIG_MODULE_UNLOAD is not set
# CONFIG_MODVERSIONS is not set
CONFIG_TRIM_UNUSED_KSYMS=y
# 手で調整していた分を defconfig に(KNL スロットに収めるため。ゼロの設定から作っても、同じ大きさになる)
# CONFIG_NVMEM is not set
# CONFIG_XCODE_LED_HEARTBEAT is not set
# USB ホスト(EHCI+OHCI)。モジュール(KNL スロットの余裕を使わない。rootfs の /lib/modules から modprobe)
CONFIG_USB=m
CONFIG_USB_EHCI_HCD=m
CONFIG_USB_EHCI_XCODE=m
CONFIG_USB_OHCI_HCD=m
CONFIG_USB_OHCI_XCODE=m
CONFIG_USB_STORAGE=m
```

## newkernel/overlay/arch/mips/xcode/Kconfig
```kconfig
# SPDX-License-Identifier: GPL-2.0
if MIPS_XCODE

config XCODE_LED_DEBUG
	bool "前面LED(GPIOポート10)で起動の進み具合を出す(UARTが無い本体のデバッグ用)"
	default n
	help
	  起動の各段階で、前面の LED_A を n 回点滅させる(Webカメラで読む)。
	  panic したときは LED_B を高速点滅する。起動が遅くなる(約30秒)ので、通常の運用では切ること。

config XCODE_LED_PANIC
	bool "panic したら前面の LED_B を高速点滅する"
	default y

config XCODE_LED_HEARTBEAT
	bool "起動後、前面の LED_B をタイマ割り込みで1秒周期に点滅する(生きている印)"
	default y

config XCODE_EARLYCON
	bool "Ethernet 経由の早期コンソール(UDP ブロードキャスト、ポート6666)"
	default y
	help
	  UART の無い基板で、起動ログ・oops・panic を LAN へ流す(受信側: socat -u UDP-RECV:6666 STDOUT)。
	  GMAC は ポーリングで TX だけ使う。

endif
```

## newkernel/overlay/drivers/net/ethernet/vixs/Kconfig
```kconfig
# SPDX-License-Identifier: GPL-2.0
config NET_VENDOR_VIXS
	bool "ViXS devices"
	default y
	depends on MIPS_XCODE
	help
	  ViXS XCode SoC(Sony nasne)のオンチップ Ethernet。

if NET_VENDOR_VIXS

config XCODE_GMAC
	tristate "ViXS XCode Ethernet (Synopsys GMAC with CSR window)"
	depends on MIPS_XCODE
	select PHYLIB
	select MARVELL_PHY
	select OF_MDIO
	help
	  XCode 4210 のオンチップ Synopsys GMAC。レジスタが SoC ラッパの CSR 窓越しで、メインラインの stmmac では扱えないため専用ドライバ。

endif # NET_VENDOR_VIXS
```
